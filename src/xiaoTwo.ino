#include <WiFi.h>
#include <esp_now.h>
#include <Wire.h>
#include <Adafruit_MPU6050.h>
#include <Adafruit_Sensor.h>

// Replace with the MAC address of the receiver ESP32S3 board
uint8_t broadcastAddress[] = {0x34, 0x85, 0x18, 0xAC, 0xB4, 0xF8}; //34:85:18:8E:29:18 60B: 34:85:18:AC:BD:6C  59A: 0x34, 0x85, 0x18, 0x91, 0x30, 0xA4
Adafruit_MPU6050 mpu;
// Structure example to send data
// Must match the receiver structure
typedef struct struct_message {
  // char a[32];
  int id; 
  bool ack;
  float b;
  float c;
  // uint8_t crc; //CRC for error checking
  bool d;  // buzzer status
} struct_message;

/*------------------ CRC-8 Calculation-----------------------*/
// CRC-8 lookup table for polynomial 0x8C (reverse of 0x31)
const uint8_t crc8_table[256] = {
0x00, 0x8C, 0x94, 0x18, 0xA4, 0x28, 0x30, 0xBC, 0xC4, 0x48, 0x50, 0xDC, 0x60, 0xEC, 0xF4, 0x78,
0x04, 0x88, 0x90, 0x1C, 0xA0, 0x2C, 0x34, 0xB8, 0xC0, 0x4C, 0x54, 0xD8, 0x64, 0xE8, 0xF0, 0x7C,
0x08, 0x84, 0x9C, 0x10, 0xAC, 0x20, 0x38, 0xB4, 0xCC, 0x40, 0x58, 0xD4, 0x68, 0xE4, 0xFC, 0x70,
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0x3C, 0xB0, 0xA8, 0x24, 0x98, 0x14, 0x0C, 0x80, 0xF8, 0x74, 0x6C, 0xE0, 0x5C, 0xD0, 0xC8, 0x44
};
// Function to calculate CRC-8
uint8_t calculateCRC8(const void* data, size_t length) {
    uint8_t crc = 0;
    uint8_t* buffer = (uint8_t*)data;

    for (size_t i = 0; i < length; i++) {
      
        crc = crc8_table[crc ^ buffer[i]];
    }

    return crc;
}

// Create a struct_message called myData
struct_message myData;

esp_now_peer_info_t peerInfo;

// callback when data is sent
static void OnDataSent(const uint8_t *mac_addr, esp_now_send_status_t status) {
  Serial.print("\r\nLast Packet Send Status:\t");
  Serial.println(status == ESP_NOW_SEND_SUCCESS ? "Delivery Success" : "Delivery Fail");
}
 
void setup() {
  // Init Serial Monitor
  Serial.begin(115200);
  

  if (!mpu.begin()) {
    Serial.println("Sensor init failed");
    while (1);
  }
  
  mpu.setAccelerometerRange(MPU6050_RANGE_8_G);

  // Set device as a Wi-Fi Station
  WiFi.mode(WIFI_STA);

  // Init ESP-NOW
  if (esp_now_init() != ESP_OK) {
    Serial.println("Error initializing ESP-NOW");
    return;
  }

  // Once ESPNow is successfully Init, we will register for Send CB to
  // get the status of Trasnmitted packet
  esp_now_register_send_cb(OnDataSent);
  
  // Register peer
  memcpy(peerInfo.peer_addr, broadcastAddress, 6);
  peerInfo.channel = 0;  
  peerInfo.encrypt = false;
  
  // Add peer        
  if (esp_now_add_peer(&peerInfo) != ESP_OK){
    Serial.println("Failed to add peer");
    return;
  }
}
 
void loop() {
  sensors_event_t accel, gyro, temp;

  mpu.getEvent(&accel, &gyro, &temp);
  
  // Use accel data
  float accX = accel.acceleration.x; 
 // float accY = accel.acceleration.y;
  float accZ = accel.acceleration.z;  

  // Magnitude calculation
  float accMag = sqrt(accX * accX + accZ * accZ); 
  float thresholdValue = 7.0;

  // Use a boolean variable to represent the state
  bool d= (accMag > thresholdValue);

  // Print the status to serial monitor
  Serial.println(d ? "true" : "false");
  
  delay(100);

  myData.id=2;  // Board ID
  // strcpy(myData.a, "This is Sender1-59C ");
  myData.d=d;
  //myData.c = t;

  //Calculate CRC
  uint8_t CRC =calculateCRC8(&myData, sizeof(myData));
  // Send data including CRC using ESP-NOW
  uint8_t dataToSend[sizeof(myData)+1];
  memcpy(dataToSend,&myData,sizeof(myData));
  dataToSend[sizeof(myData)] = CRC;
  // Send message via ESP-NOW
  esp_err_t result = esp_now_send(broadcastAddress, dataToSend, sizeof(dataToSend));
  if (result == ESP_OK) {
    Serial.print(myData.d);
  }
  else {
    Serial.println("Error sending the data");
  }
  delay(1000);
}